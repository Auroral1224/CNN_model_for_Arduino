#include <TensorFlowLite_ESP32.h>
#include <esp_task_wdt.h> 
#include "tensorflow/lite/micro/all_ops_resolver.h"
#include "tensorflow/lite/micro/micro_error_reporter.h"
#include "tensorflow/lite/micro/micro_interpreter.h"
#include "tensorflow/lite/micro/system_setup.h"
#include "tensorflow/lite/schema/schema_generated.h"
#include "pruned_quantized.h"


namespace {
tflite::ErrorReporter* error_reporter = nullptr;
const tflite::Model* model = nullptr;
tflite::MicroInterpreter* interpreter = nullptr;
TfLiteTensor* input = nullptr;
TfLiteTensor* output = nullptr;
// Create an area of memory to use for input, output, and intermediate arrays.
// Finding the minimum value for your model may require some trial and error.
constexpr int tensor_arena_size = 60*1024;
uint8_t tensor_arena[tensor_arena_size];
}

void setup() {
  // Define the input and output tensor shapes of the model
  const int INPUT_DIM = 28;
  const int OUTPUT_CLASSES = 10;
  const int INPUT_SIZE = INPUT_DIM * INPUT_DIM;
  const int TENSOR_INPUT[4] = {1, INPUT_DIM, INPUT_DIM, 1};
  const int TENSOR_OUTPUT[2] = {1, OUTPUT_CLASSES};

  Serial.begin(115200);
  
  // Set up logging
  static tflite::MicroErrorReporter micro_error_reporter;
  error_reporter = &micro_error_reporter;

  // Load the TFLite model from the memory buffer
  model = tflite::GetModel(pruned_quantized_tflite);
  if (model->version() != TFLITE_SCHEMA_VERSION) {
    error_reporter->Report(
        "Model provided is schema version %d not equal "
        "to supported version %d.\n",
        model->version(), TFLITE_SCHEMA_VERSION);
    return;
  }
  
  // Instantiate operations resolver
  static tflite::MicroMutableOpResolver<5> resolver;
  resolver.AddMaxPool2D();
  resolver.AddConv2D();
  resolver.AddFullyConnected();
  resolver.AddReshape();
  resolver.AddSoftmax();

  
  // Instantiate interpreter
  static tflite::MicroInterpreter static_interpreter(
      model, resolver, tensor_arena,tensor_arena_size, error_reporter);
  interpreter = &static_interpreter;

  // Allocate memory from the tensor_arena for the model's tensors
  TfLiteStatus allocate_status = interpreter->AllocateTensors();
  if (allocate_status != kTfLiteOk) {
    error_reporter->Report("AllocateTensors() failed");
    return;
  }

  // Obtain pointers to the model's input and output tensors
  input = interpreter->input(0);
  output = interpreter->output(0);

    // Prepare the input tensor with test data
  //float input_data[INPUT_SIZE] = {0.0, 0.0, 0.0, 0.0, 0.0, 0.0, 0.0, 0.0, 0.0, 0.0, 0.0, 0.0, 0.0,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 0.0, 0.0};
  int input_data[INPUT_SIZE] = {0, 0, 0, 0, 0, 0, 0, 0, 0, 0, 0, 0, 0,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 0, 0};
  for (int i = 0; i < INPUT_SIZE; i++) {
    input->data.f[i] = input_data[i]; // The input data is between 0 and 1 (if quantized then input=0~255)
  }
  unsigned long start_time = millis();
  // Run inference, and report any error
  TfLiteStatus invoke_status = interpreter->Invoke();
  if (invoke_status != kTfLiteOk) {
    error_reporter->Report("Invoke failed.\n");
    return;
  }
  unsigned long end_time = millis();
  // Print the output tensor values
  for (int i = 0; i < OUTPUT_CLASSES; i++) {
    Serial.print(output->data.f[i]);
    Serial.print("\t");
  }
  Serial.println();

  // Calculate the predicted class
  int predicted_class = 0;
  float max_value = output->data.f[0];
  for (int i = 1; i < OUTPUT_CLASSES; i++) {
    if (output->data.f[i] > max_value) {
      max_value = output->data.f[i];
      predicted_class = i;
    }
  }

  // Print the predicted class
  Serial.print("Predicted class: ");
  Serial.println(predicted_class);
  Serial.print("Inference latency: ");
  Serial.print(end_time - start_time);
  Serial.println(" ms");
}

void loop() {
}
